## buildroot/package/unipi-control/Config.in
```kconfig
config BR2_PACKAGE_UNIPI_CONTROL
	bool "Unipi Control"
	select BR2_PACKAGE_UNIPI_KERNEL
	select BR2_PACKAGE_UNIPI_TOOLS
	help
	  Control Unipi I/O directly with MQTT commands and without Evok. Unipi Control use Modbus for fast access to
	  the I/O and provide MQTT topics for reading and writing the circuits. Optionally you can enable the
	  Home Assistant MQTT discovery for binary sensors, sensors, switches and covers.

	  https://https://github.com/mh-superbox/unipi-control
```

## buildroot/package/unipi-firmware-tools/Config.in
```kconfig
config BR2_PACKAGE_UNIPI_FIRMWARE_TOOLS
	bool "Unipi firmware tools"
	select BR2_PACKAGE_UNIPI_MODBUS_TOOLS
	help
	  Firmware utilities for Unipi controllers.

	  https://repo.unipi.technology/debian/pool
```

## buildroot/package/unipi-firmware/Config.in
```kconfig
config BR2_PACKAGE_UNIPI_FIRMWARE
	bool "Unipi firmware tools"
	select BR2_PACKAGE_UNIPI_FIRMWARE_TOOLS
	help
	  Firmware files for Unipi boards.

	  https://repo.unipi.technology/debian/pool
```

## buildroot/package/unipi-kernel-modules-v1/Config.in
```kconfig
config BR2_PACKAGE_UNIPI_KERNEL_MODULES_V1
	bool "Unipi kernel modules v1"
	depends on BR2_LINUX_KERNEL
	help
	  Kernel modules for Unipi controllers
	  Tested for kernel versions 4.11 .. 4.19

	  https://github.com/UniPiTechnology/unipi-kernel-modules-v1
```

## buildroot/package/unipi-kernel-modules/Config.in
```kconfig
config BR2_PACKAGE_UNIPI_KERNEL_MODULES
	bool "Unipi kernel modules"
	depends on BR2_LINUX_KERNEL
	help
	  Kernel modules for Unipi devices
	  Tested for kernel versions 5.10 .. 5.15.5

	  https://github.com/UniPiTechnology/unipi-kernel-modules
```

## buildroot/package/unipi-kernel/Config.in
```kconfig
config BR2_PACKAGE_UNIPI_KERNEL
	bool "Unipi kernel modules"
	depends on BR2_LINUX_KERNEL
	help
	  Kernel modules required for UniPi Neuron/Axon PLC

	  https://github.com/UniPiTechnology/unipi-kernel
```

## buildroot/package/unipi-modbus-tools/Config.in
```kconfig
config BR2_PACKAGE_UNIPI_MODBUS_TOOLS
	bool "Unipi modbus tools"
	select BR2_PACKAGE_UNIPI_KERNEL_MODULES_V1
	select BR2_PACKAGE_LIBMODBUS 
	select BR2_PACKAGE_LIBTOOL
	help
	  Modbus TCP server for Unipi controllers.

	  https://repo.unipi.technology/debian/pool
```

## buildroot/package/unipi-os-configurator-data/Config.in
```kconfig
config BR2_PACKAGE_UNIPI_OS_CONFIGURATOR_DATA
	bool "Unipi OS configurator data"
	select BR2_PACKAGE_UNIPI_KERNEL_MODULES
	help
	  Unipi Neuron specific data for Unipi OS configurator

	  https://repo.unipi.technology/debian/pool
```

## buildroot/package/unipi-python-asyncio-mqtt/Config.in
```kconfig
config BR2_PACKAGE_UNIPI_PYTHON_ASYNCIO_MQTT
	bool "Unipi Control python-asyncio-mqtt"
	select BR2_PACKAGE_UNIPI_PYTHON_PAHO_MQTT

	help
	  Idomatic asyncio wrapper around paho-mqtt

	  https://github.com/sbtinstruments/asyncio-mqtt
```

## buildroot/package/unipi-python-paho-mqtt/Config.in
```kconfig
config BR2_PACKAGE_UNIPI_PYTHON_PAHO_MQTT
	bool "Unipi Control python-paho-mytt"

	help
	  MQTT version 5.0/3.1.1 client class

	  https://pypi.org/project/paho-mqtt
```

## buildroot/package/unipi-python-pymodbus/Config.in
```kconfig
config BR2_PACKAGE_UNIPI_PYTHON_PYMODBUS
	bool "Unipi Control python-pymodbus"
	select BR2_PACKAGE_PYTHON_SERIAL
	select BR2_PACKAGE_PYTHON_SIX

	help
	  A full modbus protocol written in python

	  https://github.com/riptideio/pymodbus
```
