## Config.in
```kconfig
source "$BR2_EXTERNAL_UNIPI_PATH/package/unipi_kernel/Config.in"
source "$BR2_EXTERNAL_UNIPI_PATH/package/unipi_tools/Config.in"
```

## buildroot-external/Config.in
```kconfig
comment "Unipi packages"
source "$BR2_EXTERNAL_UNIPI_PATH/package/unipi-kernel-modules/Config.in"
source "$BR2_EXTERNAL_UNIPI_PATH/package/unipi-os-configurator/Config.in"
source "$BR2_EXTERNAL_UNIPI_PATH/package/unipi-os-configurator-data/Config.in"

comment "Shell optimizations"
source "$BR2_EXTERNAL_UNIPI_PATH/package/zsh-autosuggestions/Config.in"
source "$BR2_EXTERNAL_UNIPI_PATH/package/zsh-history-substring-search/Config.in"

comment "Package manager"
source "$BR2_EXTERNAL_UNIPI_PATH/package/ucos-opkg/Config.in"
```

## buildroot-external/configs/neuron_rpi3_64_defconfig
```kconfig
BR2_aarch64=y
BR2_ARM_FPU_VFPV4=y
BR2_CCACHE=y
BR2_TOOLCHAIN_BUILDROOT_GLIBC=y
BR2_PACKAGE_HOST_LINUX_HEADERS_CUSTOM_5_10=y
BR2_BINUTILS_VERSION_2_37_X=y
BR2_GCC_VERSION_11_X=y
BR2_TOOLCHAIN_BUILDROOT_CXX=y
BR2_TARGET_GENERIC_HOSTNAME="unipi"
BR2_TARGET_GENERIC_ISSUE="Unipi Control OS"
BR2_TARGET_GENERIC_PASSWD_SHA512=y
BR2_INIT_SYSTEMD=y
BR2_ROOTFS_DEVICE_TABLE="$(BR2_EXTERNAL_UNIPI_PATH)/board/common/device_table.txt system/device_table.txt"
BR2_ROOTFS_DEVICE_TABLE_SUPPORTS_EXTENDED_ATTRIBUTES=y
BR2_TARGET_GENERIC_ROOT_PASSWD="unipi"
BR2_SYSTEM_BIN_SH_DASH=y
BR2_TARGET_GENERIC_GETTY_PORT="tty1"
BR2_TARGET_GENERIC_GETTY_BAUDRATE_115200=y
BR2_SYSTEM_DEFAULT_PATH="/bin:/sbin:/usr/bin:/usr/sbin"
BR2_ENABLE_LOCALE_WHITELIST="C en_US en_GB"
BR2_TARGET_LOCALTIME="Europe/Vienna"
BR2_ROOTFS_USERS_TABLES="$(BR2_EXTERNAL_UNIPI_PATH)/board/common/users_table.txt"
BR2_ROOTFS_OVERLAY="$(BR2_EXTERNAL_UNIPI_PATH)/board/common/rootfs-overlay $(BR2_EXTERNAL_UNIPI_PATH)/board/neuron/rootfs-overlay"
BR2_ROOTFS_POST_BUILD_SCRIPT="$(BR2_EXTERNAL_UNIPI_PATH)/board/common/post-build.sh"
BR2_ROOTFS_POST_IMAGE_SCRIPT="$(BR2_EXTERNAL_UNIPI_PATH)/board/common/post-image.sh"
BR2_ROOTFS_POST_SCRIPT_ARGS="$(BR2_EXTERNAL_UNIPI_PATH)/board/neuron/rpi3-64"
BR2_LINUX_KERNEL=y
BR2_LINUX_KERNEL_CUSTOM_TARBALL=y
BR2_LINUX_KERNEL_CUSTOM_TARBALL_LOCATION="$(call github,raspberrypi,linux,0b54dbda3cca2beb51e236a25738784e90853b64)/linux-0b54dbda3cca2beb51e236a25738784e90853b64.tar.gz"
BR2_LINUX_KERNEL_DEFCONFIG="bcmrpi3"
BR2_LINUX_KERNEL_CONFIG_FRAGMENT_FILES="$(BR2_EXTERNAL_UNIPI_PATH)/board/common/linux.config"
BR2_LINUX_KERNEL_ZSTD=y
BR2_LINUX_KERNEL_DTS_SUPPORT=y
BR2_LINUX_KERNEL_INTREE_DTS_NAME="broadcom/bcm2710-rpi-3-b broadcom/bcm2710-rpi-3-b-plus broadcom/bcm2837-rpi-3-b"
BR2_LINUX_KERNEL_NEEDS_HOST_OPENSSL=y
BR2_PACKAGE_LINUX_TOOLS_CPUPOWER=y
BR2_PACKAGE_BUSYBOX_CONFIG_FRAGMENT_FILES="$(BR2_EXTERNAL_UNIPI_PATH)/board/common/busybox.config"
BR2_PACKAGE_BUSYBOX_WATCHDOG=y
BR2_PACKAGE_GZIP=y
BR2_PACKAGE_ZSTD=y
BR2_PACKAGE_BINUTILS=y
BR2_PACKAGE_DIFFUTILS=y
BR2_PACKAGE_FINDUTILS=y
BR2_PACKAGE_GIT=y
BR2_PACKAGE_GREP=y
BR2_PACKAGE_JQ=y
BR2_PACKAGE_MAKE=y
BR2_PACKAGE_PATCH=y
BR2_PACKAGE_SED=y
BR2_PACKAGE_TREE=y
BR2_PACKAGE_DOSFSTOOLS=y
BR2_PACKAGE_DOSFSTOOLS_FSCK_FAT=y
BR2_PACKAGE_E2FSPROGS=y
BR2_PACKAGE_E2FSPROGS_RESIZE2FS=y
BR2_PACKAGE_FUSE_OVERLAYFS=y
# BR2_PACKAGE_SQUASHFS_GZIP is not set
BR2_PACKAGE_SQUASHFS_LZ4=y
BR2_PACKAGE_BRCMFMAC_SDIO_FIRMWARE_RPI=y
BR2_PACKAGE_BRCMFMAC_SDIO_FIRMWARE_RPI_BT=y
BR2_PACKAGE_BRCMFMAC_SDIO_FIRMWARE_RPI_WIFI=y
BR2_PACKAGE_RPI_FIRMWARE=y
BR2_PACKAGE_RPI_FIRMWARE_BOOTCODE_BIN=y
BR2_PACKAGE_RPI_FIRMWARE_VARIANT_PI=y
BR2_PACKAGE_RPI_FIRMWARE_CONFIG_FILE="$(BR2_EXTERNAL_UNIPI_PATH)/board/neuron/config.txt"
BR2_PACKAGE_GPTFDISK=y
BR2_PACKAGE_GPTFDISK_SGDISK=y
BR2_PACKAGE_I2C_TOOLS=y
BR2_PACKAGE_LSHW=y
# BR2_PACKAGE_LVM2_STANDARD_INSTALL is not set
BR2_PACKAGE_MINICOM=y
BR2_PACKAGE_PARTED=y
BR2_PACKAGE_RASPI_GPIO=y
BR2_PACKAGE_RS485CONF=y
BR2_PACKAGE_RTC_TOOLS=y
BR2_PACKAGE_USBUTILS=y
BR2_PACKAGE_PYTHON3_PY_PYC=y
BR2_PACKAGE_PYTHON3_BZIP2=y
BR2_PACKAGE_PYTHON3_DECIMAL=y
BR2_PACKAGE_PYTHON3_READLINE=y
BR2_PACKAGE_PYTHON3_SQLITE=y
BR2_PACKAGE_PYTHON3_XZ=y
BR2_PACKAGE_PYTHON_PIP=y
BR2_PACKAGE_LIBARCHIVE=y
BR2_PACKAGE_LZO=y
BR2_PACKAGE_ZLIB_NG=y
BR2_PACKAGE_CA_CERTIFICATES=y
BR2_PACKAGE_GNUTLS=y
BR2_PACKAGE_LIBGPGME=y
BR2_PACKAGE_LIBOPENSSL_BIN=y
BR2_PACKAGE_LIBOPENSSL_ENGINES=y
# BR2_PACKAGE_LIBOPENSSL_ENABLE_WEAK_SSL is not set
# BR2_PACKAGE_LIBOPENSSL_UNSECURE is not set
BR2_PACKAGE_LIBFUSE=y
BR2_PACKAGE_LIBFTDI=y
BR2_PACKAGE_OWFS=y
BR2_PACKAGE_LIBCURL_CURL=y
BR2_PACKAGE_LIBPCAP=y
BR2_PACKAGE_LIBTIRPC=y
BR2_PACKAGE_CMOCKA=y
BR2_PACKAGE_LIBEVENT=y
BR2_PACKAGE_LIBLINEAR=y
BR2_PACKAGE_LIBSECCOMP=y
BR2_PACKAGE_NCURSES_WCHAR=y
BR2_PACKAGE_AVAHI=y
BR2_PACKAGE_AVAHI_DAEMON=y
BR2_PACKAGE_IPROUTE2=y
BR2_PACKAGE_IPUTILS=y
# BR2_PACKAGE_IPUTILS_CLOCKDIFF is not set
# BR2_PACKAGE_IPUTILS_RDISC is not set
# BR2_PACKAGE_IPUTILS_NINFOD is not set
BR2_PACKAGE_IW=y
BR2_PACKAGE_MOSQUITTO=y
BR2_PACKAGE_NET_TOOLS=y
BR2_PACKAGE_NETCAT=y
BR2_PACKAGE_OPENSSH=y
BR2_PACKAGE_RSYNC=y
BR2_PACKAGE_TRACEROUTE=y
BR2_PACKAGE_WGET=y
BR2_PACKAGE_WIRELESS_REGDB=y
BR2_PACKAGE_WPA_SUPPLICANT=y
BR2_PACKAGE_WPA_SUPPLICANT_WEXT=y
BR2_PACKAGE_WPA_SUPPLICANT_AP_SUPPORT=y
BR2_PACKAGE_WPA_SUPPLICANT_DBUS=y
BR2_PACKAGE_WPA_SUPPLICANT_DBUS_INTROSPECTION=y
BR2_PACKAGE_BASH=y
BR2_PACKAGE_ZSH=y
BR2_PACKAGE_BASH_COMPLETION=y
BR2_PACKAGE_FILE=y
BR2_PACKAGE_GNUPG2=y
BR2_PACKAGE_INOTIFY_TOOLS=y
BR2_PACKAGE_LOGROTATE=y
BR2_PACKAGE_SCREEN=y
BR2_PACKAGE_SUDO=y
BR2_PACKAGE_TIME=y
BR2_PACKAGE_WHICH=y
BR2_PACKAGE_ATTR=y
BR2_PACKAGE_COREUTILS=y
BR2_PACKAGE_DOCKER_CLI=y
BR2_PACKAGE_DOCKER_COMPOSE=y
BR2_PACKAGE_DOCKER_ENGINE=y
BR2_PACKAGE_DOCKER_ENGINE_DRIVER_DEVICEMAPPER=y
BR2_PACKAGE_DOCKER_ENGINE_DRIVER_VFS=y
BR2_PACKAGE_HTOP=y
BR2_PACKAGE_IOTOP=y
BR2_PACKAGE_KEYUTILS=y
BR2_PACKAGE_MONIT=y
BR2_PACKAGE_PROCPS_NG=y
BR2_PACKAGE_PSMISC=y
BR2_PACKAGE_PWGEN=y
BR2_PACKAGE_RAUC=y
BR2_PACKAGE_RAUC_DBUS=y
BR2_PACKAGE_RAUC_NETWORK=y
BR2_PACKAGE_SYSTEMD_ANALYZE=y
BR2_PACKAGE_SYSTEMD_JOURNAL_REMOTE=y
# BR2_PACKAGE_SYSTEMD_PSTORE is not set
BR2_PACKAGE_SYSTEMD_FIRSTBOOT=y
BR2_PACKAGE_SYSTEMD_HOMED=y
# BR2_PACKAGE_SYSTEMD_HOSTNAMED is not set
# BR2_PACKAGE_SYSTEMD_HWDB is not set
BR2_PACKAGE_SYSTEMD_IMPORTD=y
BR2_PACKAGE_SYSTEMD_LOGIND=y
BR2_PACKAGE_SYSTEMD_MACHINED=y
BR2_PACKAGE_SYSTEMD_RANDOMSEED=y
# BR2_PACKAGE_SYSTEMD_VCONSOLE is not set
BR2_PACKAGE_TAR=y
BR2_PACKAGE_UTIL_LINUX_CHFN_CHSH=y
BR2_PACKAGE_UTIL_LINUX_FALLOCATE=y
BR2_PACKAGE_UTIL_LINUX_HWCLOCK=y
BR2_PACKAGE_UTIL_LINUX_KILL=y
BR2_PACKAGE_UTIL_LINUX_LAST=y
BR2_PACKAGE_UTIL_LINUX_LOGIN=y
BR2_PACKAGE_UTIL_LINUX_LSLOGINS=y
BR2_PACKAGE_UTIL_LINUX_MESG=y
BR2_PACKAGE_UTIL_LINUX_MORE=y
BR2_PACKAGE_UTIL_LINUX_NOLOGIN=y
BR2_PACKAGE_UTIL_LINUX_PARTX=y
BR2_PACKAGE_UTIL_LINUX_SETPRIV=y
BR2_PACKAGE_UTIL_LINUX_SU=y
BR2_PACKAGE_UTIL_LINUX_SULOGIN=y
BR2_PACKAGE_UTIL_LINUX_SWITCH_ROOT=y
BR2_PACKAGE_UTIL_LINUX_ZRAMCTL=y
BR2_PACKAGE_BAT=y
BR2_PACKAGE_NANO=y
BR2_PACKAGE_VIM=y
BR2_TARGET_ROOTFS_SQUASHFS=y
BR2_TARGET_ROOTFS_SQUASHFS4_LZO=y
# BR2_TARGET_ROOTFS_TAR is not set
BR2_TARGET_UBOOT=y
BR2_TARGET_UBOOT_BOARD_DEFCONFIG="rpi_3"
BR2_TARGET_UBOOT_CONFIG_FRAGMENT_FILES="$(BR2_EXTERNAL_UNIPI_PATH)/board/neuron/u-boot.config"
BR2_PACKAGE_HOST_DOSFSTOOLS=y
BR2_PACKAGE_HOST_DTC=y
BR2_PACKAGE_HOST_E2FSPROGS=y
BR2_PACKAGE_HOST_GENIMAGE=y
BR2_PACKAGE_HOST_MTOOLS=y
BR2_PACKAGE_HOST_RAUC=y
BR2_PACKAGE_HOST_UBOOT_TOOLS=y
BR2_PACKAGE_HOST_UBOOT_TOOLS_ENVIMAGE=y
BR2_PACKAGE_HOST_UBOOT_TOOLS_ENVIMAGE_SIZE="0x8000"
BR2_PACKAGE_HOST_UBOOT_TOOLS_ENVIMAGE_REDUNDANT=y
BR2_PACKAGE_HOST_UBOOT_TOOLS_BOOT_SCRIPT=y
BR2_PACKAGE_HOST_UBOOT_TOOLS_BOOT_SCRIPT_SOURCE="$(BR2_EXTERNAL_UNIPI_PATH)/board/neuron/u-boot.ush"
BR2_PACKAGE_UNIPI_TOOLS=y
BR2_PACKAGE_ZSH_AUTOSUGGESTIONS=y
BR2_PACKAGE_ZSH_HISTORY_SUBSTRING_SEARCH=y
```

## buildroot-external/package/ucos-opkg/Config.in
```kconfig
config BR2_PACKAGE_UCOS_OPKG
	bool "opkg"
	depends on BR2_USE_MMU
	depends on BR2_USE_WCHAR # libarchive
	depends on BR2_PACKAGE_LIBGPG_ERROR_ARCH_SUPPORTS # libgpg-error
	select BR2_PACKAGE_LIBARCHIVE
	select BR2_PACKAGE_LIBGPGME
	select BR2_PACKAGE_LIBGPG_ERROR
	select BR2_PACKAGE_LIBCURL_CURL
	help
	  Opkg is a lightweight package management system, based on
	  ipkg.

	  https://code.google.com/archive/p/opkg/
```

## buildroot-external/package/unipi-kernel-modules-v2/Config.in
```kconfig
config BR2_PACKAGE_UNIPI_KERNEL_MODULES_V2
	bool "Unipi kernel modules v2"
	depends on BR2_LINUX_KERNEL
	help
	  Kernel modules for Unipi Neuron
	  Tested for kernel versions 5.10 .. 5.15.5

	  https://github.com/UniPiTechnology/unipi-kernel-modules
```

## buildroot-external/package/unipi-kernel-modules/Config.in
```kconfig
config BR2_PACKAGE_UNIPI_KERNEL_MODULES
	bool "Unipi kernel modules"
	depends on BR2_LINUX_KERNEL
	help
	  Unipi Neuron kernel modules - DKMS source
```

## buildroot-external/package/unipi-os-configurator-data/Config.in
```kconfig
config BR2_PACKAGE_UNIPI_OS_CONFIGURATOR_DATA
	bool "Unipi OS configurator data"
	depends on BR2_PACKAGE_UNIPI_OS_CONFIGURATOR
	help
	  Unipi Neuron specific data for Unipi OS configurator
```

## buildroot-external/package/unipi-os-configurator/Config.in
```kconfig
config BR2_PACKAGE_UNIPI_OS_CONFIGURATOR
	bool "Unipi OS configurator"
	select BR2_PACKAGE_UNIPI_OS_CONFIGURATOR_DATA
	help
	  Binaries and scripts for Unipi OS configurator
```

## buildroot-external/package/unipi-rpi-firmware-overlays/Config.in
```kconfig
config BR2_PACKAGE_UNIPI_RPI_FIRMWARE_OVERLAYS
	bool "Unipi rpi-firmware overlays"
	select BR2_PACKAGE_UNIPI_KERNEL_MODULES_V2
	help
	  Unipi Rasberry firmware overlays

	  https://github.com/UniPiTechnology/unipi-tools
```

## buildroot-external/package/zsh-history-substring-search/Config.in
```kconfig
config BR2_PACKAGE_ZSH_HISTORY_SUBSTRING_SEARCH
	bool "zsh-history-substring-search"
	depends on BR2_PACKAGE_ZSH
	help
	  ZSH port of Fish history search (up arrow)

	  https://github.com/zsh-users/zsh-history-substring-search
```

## buildroot/Config.in
```kconfig
comment "Unipi packages (v1)"
source "$BR2_EXTERNAL_UNIPI_PATH/package/unipi-kernel-modules-v1/Config.in"
source "$BR2_EXTERNAL_UNIPI_PATH/package/unipi-tools/Config.in"

comment "Unipi packages (v2)"
source "$BR2_EXTERNAL_UNIPI_PATH/package/unipi-kernel-modules/Config.in"
source "$BR2_EXTERNAL_UNIPI_PATH/package/unipi-modbus-tools/Config.in"
source "$BR2_EXTERNAL_UNIPI_PATH/package/unipi-firmware-tools/Config.in"
source "$BR2_EXTERNAL_UNIPI_PATH/package/unipi-firmware/Config.in"
source "$BR2_EXTERNAL_UNIPI_PATH/package/unipi-firmware6/Config.in"
source "$BR2_EXTERNAL_UNIPI_PATH/package/unipi-os-configurator-data/Config.in"

comment "Shell optimizations"
source "$BR2_EXTERNAL_UNIPI_PATH/package/zsh-autosuggestions/Config.in"
source "$BR2_EXTERNAL_UNIPI_PATH/package/zsh-history-substring-search/Config.in"
```

## buildroot/configs/unipi_neuron_rpi3b_defconfig
```kconfig
BR2_aarch64=y
BR2_ARM_FPU_VFPV4=y
BR2_SSP_STRONG=y
BR2_RELRO_FULL=y
BR2_FORTIFY_SOURCE_1=y
BR2_TOOLCHAIN_BUILDROOT_GLIBC=y
BR2_BINUTILS_VERSION_2_36_X=y
BR2_GCC_VERSION_10_X=y
BR2_TOOLCHAIN_BUILDROOT_CXX=y
BR2_TARGET_GENERIC_HOSTNAME="unipi"
BR2_TARGET_GENERIC_ISSUE="Welcome to Unipi"
BR2_TARGET_GENERIC_PASSWD_SHA512=y
BR2_INIT_SYSTEMD=y
BR2_ROOTFS_DEVICE_TABLE="$(BR2_EXTERNAL_UNIPI_PATH)/board/common/device_table.txt system/device_table.txt"
BR2_TARGET_GENERIC_ROOT_PASSWD="unipi"
BR2_SYSTEM_BIN_SH_DASH=y
BR2_TARGET_GENERIC_GETTY_PORT="tty1"
BR2_TARGET_GENERIC_GETTY_BAUDRATE_115200=y
BR2_SYSTEM_DEFAULT_PATH="/bin:/sbin:/usr/bin:/usr/sbin"
BR2_ENABLE_LOCALE_WHITELIST="C en_US en_GB"
BR2_TARGET_LOCALTIME="Europe/Vienna"
BR2_ROOTFS_USERS_TABLES="$(BR2_EXTERNAL_UNIPI_PATH)/board/common/users_table.txt"
BR2_ROOTFS_OVERLAY="$(BR2_EXTERNAL_UNIPI_PATH)/board/common/rootfs_overlay"
BR2_ROOTFS_POST_BUILD_SCRIPT="$(BR2_EXTERNAL_UNIPI_PATH)/board/common/post-build.sh board/raspberrypi3-64/post-build.sh"
BR2_ROOTFS_POST_IMAGE_SCRIPT="$(BR2_EXTERNAL_UNIPI_PATH)/board/unipi/neuron/post-image.sh board/raspberrypi3-64/post-image.sh"
BR2_ROOTFS_POST_SCRIPT_ARGS="--aarch64 --add-miniuart-bt-overlay --add-neuron-overlay"
BR2_LINUX_KERNEL=y
BR2_LINUX_KERNEL_CUSTOM_TARBALL=y
BR2_LINUX_KERNEL_CUSTOM_TARBALL_LOCATION="$(call github,raspberrypi,linux,b657cd2f27d9171b75c846f21e7b4bb581b3ed29)/linux-b657cd2f27d9171b75c846f21e7b4bb581b3ed29.tar.gz"
BR2_LINUX_KERNEL_DEFCONFIG="bcmrpi3"
BR2_LINUX_KERNEL_DTS_SUPPORT=y
BR2_LINUX_KERNEL_INTREE_DTS_NAME="broadcom/bcm2710-rpi-3-b broadcom/bcm2710-rpi-3-b-plus broadcom/bcm2837-rpi-3-b"
BR2_LINUX_KERNEL_NEEDS_HOST_OPENSSL=y
BR2_PACKAGE_BUSYBOX_WATCHDOG=y
BR2_PACKAGE_GZIP=y
BR2_PACKAGE_P7ZIP=y
BR2_PACKAGE_UNRAR=y
BR2_PACKAGE_UNZIP=y
BR2_PACKAGE_ZIP=y
BR2_PACKAGE_BINUTILS=y
BR2_PACKAGE_FINDUTILS=y
BR2_PACKAGE_GIT=y
BR2_PACKAGE_GREP=y
BR2_PACKAGE_MAKE=y
BR2_PACKAGE_PATCH=y
BR2_PACKAGE_PKGCONF=y
BR2_PACKAGE_SED=y
BR2_PACKAGE_TREE=y
BR2_PACKAGE_DOSFSTOOLS=y
BR2_PACKAGE_DOSFSTOOLS_FSCK_FAT=y
BR2_PACKAGE_RPI_BT_FIRMWARE=y
BR2_PACKAGE_RPI_FIRMWARE=y
BR2_PACKAGE_RPI_WIFI_FIRMWARE=y
BR2_PACKAGE_I2C_TOOLS=y
BR2_PACKAGE_PARTED=y
BR2_PACKAGE_RASPI_GPIO=y
BR2_PACKAGE_RS485CONF=y
BR2_PACKAGE_RTC_TOOLS=y
BR2_PACKAGE_USBUTILS=y
BR2_PACKAGE_PYTHON3=y
BR2_PACKAGE_PYTHON3_PY_PYC=y
BR2_PACKAGE_PYTHON3_BZIP2=y
BR2_PACKAGE_PYTHON3_DECIMAL=y
BR2_PACKAGE_PYTHON3_READLINE=y
BR2_PACKAGE_PYTHON3_SQLITE=y
BR2_PACKAGE_PYTHON3_XZ=y
BR2_PACKAGE_PYTHON_IPYTHON=y
BR2_PACKAGE_PYTHON_PIP=y
BR2_PACKAGE_CA_CERTIFICATES=y
BR2_PACKAGE_LIBOPENSSL_BIN=y
BR2_PACKAGE_LIBOPENSSL_ENGINES=y
BR2_PACKAGE_LIBFUSE=y
BR2_PACKAGE_LIBFTDI1=y
BR2_PACKAGE_OWFS=y
BR2_PACKAGE_LIBXSLT=y
BR2_PACKAGE_LIBCURL=y
BR2_PACKAGE_LIBCURL_CURL=y
BR2_PACKAGE_AVAHI=y
BR2_PACKAGE_AVAHI_DAEMON=y
BR2_PACKAGE_IPUTILS=y
# BR2_PACKAGE_IPUTILS_CLOCKDIFF is not set
# BR2_PACKAGE_IPUTILS_RDISC is not set
# BR2_PACKAGE_IPUTILS_NINFOD is not set
BR2_PACKAGE_MOSQUITTO=y
BR2_PACKAGE_NET_TOOLS=y
BR2_PACKAGE_NETCAT=y
BR2_PACKAGE_OPENSSH=y
BR2_PACKAGE_RSYNC=y
BR2_PACKAGE_TRACEROUTE=y
BR2_PACKAGE_WGET=y
BR2_PACKAGE_WIRELESS_REGDB=y
BR2_PACKAGE_WIRELESS_TOOLS=y
BR2_PACKAGE_WIRELESS_TOOLS_LIB=y
BR2_PACKAGE_WPA_SUPPLICANT=y
BR2_PACKAGE_WPA_SUPPLICANT_AUTOSCAN=y
BR2_PACKAGE_WPA_SUPPLICANT_EAP=y
BR2_PACKAGE_WPA_SUPPLICANT_WPA3=y
BR2_PACKAGE_WPA_SUPPLICANT_CLI=y
BR2_PACKAGE_WPA_SUPPLICANT_WPA_CLIENT_SO=y
BR2_PACKAGE_WPA_SUPPLICANT_PASSPHRASE=y
BR2_PACKAGE_WPA_SUPPLICANT_DBUS=y
BR2_PACKAGE_WPA_SUPPLICANT_DBUS_INTROSPECTION=y
BR2_PACKAGE_ZSH=y
BR2_PACKAGE_FILE=y
BR2_PACKAGE_INOTIFY_TOOLS=y
BR2_PACKAGE_SCREEN=y
BR2_PACKAGE_SUDO=y
BR2_PACKAGE_WHICH=y
BR2_PACKAGE_ATOP=y
BR2_PACKAGE_COREUTILS=y
BR2_PACKAGE_FTOP=y
BR2_PACKAGE_HTOP=y
BR2_PACKAGE_IOTOP=y
BR2_PACKAGE_MONIT=y
BR2_PACKAGE_PROCPS_NG=y
BR2_PACKAGE_PSMISC=y
BR2_PACKAGE_PWGEN=y
BR2_PACKAGE_SYSTEMD_FIRSTBOOT=y
BR2_PACKAGE_SYSTEMD_LOGIND=y
BR2_PACKAGE_TAR=y
BR2_PACKAGE_UTIL_LINUX_BINARIES=y
BR2_PACKAGE_UTIL_LINUX_HWCLOCK=y
BR2_PACKAGE_UTIL_LINUX_KILL=y
BR2_PACKAGE_UTIL_LINUX_LAST=y
BR2_PACKAGE_UTIL_LINUX_LOGIN=y
BR2_PACKAGE_UTIL_LINUX_LSLOGINS=y
BR2_PACKAGE_UTIL_LINUX_MORE=y
BR2_PACKAGE_UTIL_LINUX_NOLOGIN=y
BR2_PACKAGE_UTIL_LINUX_PARTX=y
BR2_PACKAGE_UTIL_LINUX_SU=y
BR2_PACKAGE_UTIL_LINUX_SULOGIN=y
BR2_PACKAGE_LESS=y
BR2_PACKAGE_NANO=y
BR2_PACKAGE_VIM=y
BR2_TARGET_ROOTFS_EXT2=y
BR2_TARGET_ROOTFS_EXT2_4=y
BR2_TARGET_ROOTFS_EXT2_SIZE="512M"
# BR2_TARGET_ROOTFS_TAR is not set
BR2_PACKAGE_HOST_DOSFSTOOLS=y
BR2_PACKAGE_HOST_GENIMAGE=y
BR2_PACKAGE_HOST_MTOOLS=y
BR2_PACKAGE_UNIPI_TOOLS=y
```

## buildroot/package/custom-python-paho-mqtt/Config.in
```kconfig
config BR2_PACKAGE_CUSTOM_PYTHON_PAHO_MQTT
	bool "python-paho-mytt"

	help
	  MQTT version 5.0/3.1.1 client class

	  https://pypi.org/project/paho-mqtt
```

## buildroot/package/python-asyncio-mqtt/Config.in
```kconfig
config BR2_PACKAGE_PYTHON_ASYNCIO_MQTT
	bool "python-asyncio-mqtt"
	select BR2_PACKAGE_PYTHON_PAHO_MQTT

	help
	  Idomatic asyncio wrapper around paho-mqtt

	  https://github.com/sbtinstruments/asyncio-mqtt
```
