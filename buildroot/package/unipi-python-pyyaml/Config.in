## buildroot/package/unipi-python-pyyaml/Config.in
```kconfig
config BR2_PACKAGE_UNIPI_PYTHON_PYYAML
	bool "Unipi Control python-pyyaml"

	help
	  YAML parser and emitter for Python

	  https://pypi.org/project/PyYAML
```

## buildroot/package/unipi-tools/Config.in
```kconfig
config BR2_PACKAGE_UNIPI_TOOLS
	bool "Unipi tools"
	select BR2_PACKAGE_UNIPI_KERNEL_MODULES_V1
	select BR2_PACKAGE_LIBMODBUS
	select BR2_PACKAGE_LIBTOOL
	help
	  * Unipi Modbus TCP server
	  * Unipi Modbus flashing utility for Unipi Neuron
	  * RTC UART Modbus flashing utility for Unipi Neuron

	  https://github.com/UniPiTechnology/unipi-tools
```

## buildroot/package/zsh-autosuggestions/Config.in
```kconfig
config BR2_PACKAGE_ZSH_AUTOSUGGESTIONS
	bool "zsh-autosuggestions"
	depends on BR2_PACKAGE_ZSH 
	help
	  Fish-like autosuggestions for zsh.

	  https://github.com/zsh-users/zsh-autosuggestions
```

## buildroot/package/zsh-syntax-highlighting/Config.in
```kconfig
config BR2_PACKAGE_ZSH_SYNTAX_HIGHLIGHTING
	bool "zsh-syntax-highlighting"
	depends on BR2_PACKAGE_ZSH 
	help
	  Fish shell like syntax highlighting for Zsh.

	  https://github.com/zsh-users/zsh-syntax-highlighting
```

## package/unipi_kernel/Config.in
```kconfig
config BR2_PACKAGE_UNIPI_KERNEL
	bool "UniPi kernel modules"
	depends on BR2_LINUX_KERNEL
	help
	  Kernel modules required for UniPi Neuron/Axon PLC

	  https://github.com/UniPiTechnology/unipi-kernel

comment "UniPi kernel needs a Linux kernel to be built"
	depends on !BR2_LINUX_KERNEL
```

## package/unipi_sysfs/Config.in
```kconfig
config BR2_PACKAGE_UNIPI_SYSFS
	bool "SysFS drivers"
	depends on BR2_LINUX_KERNEL
	help
	  SysFS driver for all Unipi units with I/O (except UniPi 1.1)
	  provides easy file-based access to all inputs and outputs of
	  the unit.

	  https://git.unipi.technology/UniPi/unipi-kernel/

comment "unipi_sysfs needs a Linux kernel to be built"
	depends on !BR2_LINUX_KERNEL
```

## package/unipi_tools/Config.in
```kconfig
config BR2_PACKAGE_UNIPI_TOOLS
	bool "UniPi tools"
	depends on BR2_PACKAGE_UNIPI_KERNEL
	select BR2_PACKAGE_LIBMODBUS 
	select BR2_PACKAGE_LIBTOOL
	help
	  * UniPi Modbus TCP server
	  * UniPi Modbus flashing utility for UniPi devices
	  * RTC UART Modbus flashing utility for UniPi devices

	  https://github.com/UniPiTechnology/unipi-tools
```
